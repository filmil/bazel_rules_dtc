/dts-v1/;

/ {
    compatible = "acme,overlay-base";
    #address-cells = <1>;
    #size-cells = <1>;

    soc {
        #address-cells = <1>;
        #size-cells = <1>;

        uart0: serial@10000000 {
            compatible = "acme,uart";
            reg = <0x10000000 0x100>;
            status = "disabled";
        };
    };
};
