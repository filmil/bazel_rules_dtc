/ {
    soc {
        #address-cells = <1>;
        #size-cells = <1>;

        gpio0: gpio@10001000 {
            compatible = "acme,gpio";
            reg = <0x10001000 0x100>;
            gpio-controller;
            #gpio-cells = <2>;
        };
    };
};
